## bsp/esp32_p4_function_ev_board/Kconfig
```kconfig
menu "Board Support Package"

    config BSP_ERROR_CHECK
        bool "Enable error check in BSP"
        default y
        help
            Error check assert the application before returning the error code.

    menu "I2C"
        config BSP_I2C_NUM
            int "I2C peripheral index"
            default 1
            range 0 1
            help
                ESP32S3 has two I2C peripherals, pick the one you want to use.

        config BSP_I2C_FAST_MODE
            bool "Enable I2C fast mode"
            default y
            help
                I2C has two speed modes: normal (100kHz) and fast (400kHz).

        config BSP_I2C_CLK_SPEED_HZ
            int
            default 400000 if BSP_I2C_FAST_MODE
            default 100000
    endmenu

    menu "SPIFFS - Virtual File System"
        config BSP_SPIFFS_FORMAT_ON_MOUNT_FAIL
            bool "Format SPIFFS if mounting fails"
            default n
            help
                Format SPIFFS if it fails to mount the filesystem.

        config BSP_SPIFFS_MOUNT_POINT
            string "SPIFFS mount point"
            default "/spiffs"
            help
                Mount point of SPIFFS in the Virtual File System.

        config BSP_SPIFFS_PARTITION_LABEL
            string "Partition label of SPIFFS"
            default "storage"
            help
                Partition label which stores SPIFFS.

        config BSP_SPIFFS_MAX_FILES
            int "Max files supported for SPIFFS VFS"
            default 5
            help
                Supported max files for SPIFFS in the Virtual File System.
    endmenu

    menu "SD card - Virtual File System"
        config BSP_SD_FORMAT_ON_MOUNT_FAIL
            bool "Format SD card if mounting fails"
            default n
            help
                The SDMMC host will format (FAT) the SD card if it fails to mount the filesystem.

        config BSP_SD_MOUNT_POINT
            string "SD card mount point"
            default "/sdcard"
            help
                Mount point of the SD card in the Virtual File System
    endmenu

    menu "Display"
        config BSP_DISPLAY_LVGL_TASK_PRIORITY
            int "LVGL task priority"
            default 2
            help
                The Board Support Package will create a task that will periodically handle LVGL operation in lv_timer_handler().

        config BSP_DISPLAY_LVGL_TASK_CORE_ID
            int "LVGL task pinned core ID"
            default -1
            range -1 1
            help
                Core to pin LVGL task. -1 means no pinning.

        config BSP_DISPLAY_LVGL_TASK_DELAY
            int "LVGL task minimum delay time (ms)"
            default 10
            range 1 100
            help
                Minimum delay time for LVGL task. It should be larger if the task watchdog is triggered frequently.

        config BSP_DISPLAY_LVGL_TASK_STACK_SIZE_KB
            int "LVGL task stack size (KB)"
            default 4
            help
                Size(KB) of LVGL task stack.

        config BSP_DISPLAY_LVGL_TICK
            int "LVGL tick period"
            default 5
            range 1 100
            help
                Period of LVGL tick timer.

        choice BSP_DISPLAY_LVGL_BUF_CAPS
            depends on !BSP_DISPLAY_LVGL_AVOID_TEAR
            prompt "Select LVGL buffer memory capability"
            default BSP_DISPLAY_LVGL_INTERNAL
            config BSP_DISPLAY_LVGL_PSRAM
                bool "PSRAM memory"
            config BSP_DISPLAY_LVGL_INTERNAL
                bool "Internal memory"
        endchoice

        config BSP_DISPLAY_LVGL_BUF_HEIGHT
            depends on !BSP_DISPLAY_LVGL_AVOID_TEAR
            int "LVGL buffer height"
            default 100
            help
                Height of LVGL buffer. The width of the buffer is the same as that of the LCD.
    endmenu

    config BSP_I2S_NUM
        int "I2S peripheral index"
        default 1
        range 0 1
        help
            ESP32S3 has two I2S peripherals, pick the one you want to use.
endmenu
```

## examples/p4/base_demo_anti_tearing/esp32_p4_function_ev_board/Kconfig
```kconfig
menu "Board Support Package"

    config BSP_ERROR_CHECK
        bool "Enable error check in BSP"
        default y
        help
            Error check assert the application before returning the error code.

    choice
        prompt "Choose Board Type"
        default BSP_BOARD_TYPE_SAMPLE
            config BSP_BOARD_TYPE_FLY_LINE
                bool "Fly Line"

            config BSP_BOARD_TYPE_FIB
                bool "FIB"

            config BSP_BOARD_TYPE_SAMPLE
                bool "Customer Sample"
    endchoice

    menu "I2C"
        config BSP_I2C_NUM
            int "I2C peripheral index"
            default 1
            range 0 1
            help
                ESP32S3 has two I2C peripherals, pick the one you want to use.

        config BSP_I2C_FAST_MODE
            bool "Enable I2C fast mode"
            default y
            help
                I2C has two speed modes: normal (100kHz) and fast (400kHz).

        config BSP_I2C_CLK_SPEED_HZ
            int
            default 400000 if BSP_I2C_FAST_MODE
            default 100000
    endmenu

    menu "SPIFFS - Virtual File System"
        config BSP_SPIFFS_FORMAT_ON_MOUNT_FAIL
            bool "Format SPIFFS if mounting fails"
            default n
            help
                Format SPIFFS if it fails to mount the filesystem.

        config BSP_SPIFFS_MOUNT_POINT
            string "SPIFFS mount point"
            default "/spiffs"
            help
                Mount point of SPIFFS in the Virtual File System.

        config BSP_SPIFFS_PARTITION_LABEL
            string "Partition label of SPIFFS"
            default "storage"
            help
                Partition label which stores SPIFFS.

        config BSP_SPIFFS_MAX_FILES
            int "Max files supported for SPIFFS VFS"
            default 5
            help
                Supported max files for SPIFFS in the Virtual File System.
    endmenu

    menu "SD card - Virtual File System"
        config BSP_SD_FORMAT_ON_MOUNT_FAIL
            bool "Format SD card if mounting fails"
            default n
            help
                The SDMMC host will format (FAT) the SD card if it fails to mount the filesystem.

        config BSP_SD_MOUNT_POINT
            string "SD card mount point"
            default "/sdcard"
            help
                Mount point of the SD card in the Virtual File System
    endmenu

    menu "LCD DSI"
        config LCD_DSI_ENABLE_DEBUG_LOG
            bool "Enable debug log"
            default y
            help
                Wether to enable the debug log message for LCD driver.
                Note that, this option only controls the LCD driver log, won't affect other drivers.

        config LCD_DSI_ISR_IRAM_SAFE
            bool "DSI LCD ISR IRAM-Safe"
            default n
            help
                Ensure the LCD interrupt is IRAM-Safe by allowing the interrupt handler to be
                executable when the cache is disabled (e.g. SPI Flash write).
                If you want the LCD driver to keep flushing the screen even when cache ops disabled,
                you can enable this option. Note, this will also increase the IRAM usage.
    endmenu

    menu "Display"
        config BSP_DISPLAY_LCD_BUFFER_NUMS
            int "Set number of frame buffers"
            default 1
            range 1 3
            help
                Let RGB LCD driver create a specified number of frame-size buffers. Only when it is set to multiple can the avoiding tearing be turned on.

        config BSP_DISPLAY_LVGL_AVOID_TEAR
            bool "Avoid tearing effect"
            depends on BSP_DISPLAY_LCD_BUFFER_NUMS > 1
            default "n"
            help
                Avoid tearing effect through LVGL buffer mode and double frame buffers of RGB LCD. This feature is only available for RGB LCD.

        choice BSP_DISPLAY_LVGL_MODE
            depends on BSP_DISPLAY_LVGL_AVOID_TEAR
            prompt "Select LVGL buffer mode"
            default BSP_DISPLAY_LVGL_FULL_REFRESH
            config BSP_DISPLAY_LVGL_FULL_REFRESH
                bool "Full refresh"
            config BSP_DISPLAY_LVGL_DIRECT_MODE
                bool "Direct mode"
        endchoice

        config BSP_DISPLAY_LVGL_TASK_PRIORITY
            int "LVGL task priority"
            default 2
            help
                The Board Support Package will create a task that will periodically handle LVGL operation in lv_timer_handler().

        config BSP_DISPLAY_LVGL_TASK_CORE_ID
            int "LVGL task pinned core ID"
            default -1
            range -1 1
            help
                Core to pin LVGL task. -1 means no pinning.

        config BSP_DISPLAY_LVGL_TASK_DELAY
            int "LVGL task minimum delay time (ms)"
            default 10
            range 1 100
            help
                Minimum delay time for LVGL task. It should be larger if the task watchdog is triggered frequently.

        config BSP_DISPLAY_LVGL_TASK_STACK_SIZE_KB
            int "LVGL task stack size (KB)"
            default 4
            help
                Size(KB) of LVGL task stack.

        config BSP_DISPLAY_LVGL_TICK
            int "LVGL tick period"
            default 5
            range 1 100
            help
                Period of LVGL tick timer.

        choice BSP_DISPLAY_LVGL_BUF_CAPS
            depends on !BSP_DISPLAY_LVGL_AVOID_TEAR
            prompt "Select LVGL buffer memory capability"
            default BSP_DISPLAY_LVGL_PSRAM
            config BSP_DISPLAY_LVGL_PSRAM
                bool "PSRAM memory"
            config BSP_DISPLAY_LVGL_INTERNAL
                bool "Internal memory"
        endchoice

        config BSP_DISPLAY_LVGL_BUF_HEIGHT
            depends on !BSP_DISPLAY_LVGL_AVOID_TEAR
            int "LVGL buffer height"
            default 100
            help
                Height of LVGL buffer. The width of the buffer is the same as that of the LCD.
    endmenu

    config BSP_I2S_NUM
        int "I2S peripheral index"
        default 1
        range 0 1
        help
            ESP32S3 has two I2S peripherals, pick the one you want to use.
endmenu
```

## examples/p4/mipi_phone_fib/main/Kconfig.projbuild
```kconfig
menu "Example Configurations"
    config EXAMPLE_USE_SD_CARD
        bool "Use SD Card"
        default n
        help
            SPIFFS will disable if use SD Card
endmenu
```
